## Linux_uvc_driver/uvc_2.6.36/Kconfig
```kconfig
config USB_VIDEO_CLASS_H264
	tristate "USB Video Class (UVC)"
	---help---
	  Support for the RERVISION H264 USB Video Class (UVC).  Currently only H264 USB Camera,
	  such as RER-USB100W04H, are supported.
```

## Linux_uvc_driver/uvc_3.3.8/Kconfig
```kconfig
config USB_VIDEO_CLASS_H264
	tristate "USB Video Class (UVC)"
	select VIDEOBUF2_VMALLOC
	---help---
	  Support for the RERVISION H264 USB Video Class (UVC).  Currently only H264 USB Camera,
	  such as RER-USB100W04H, are supported.
```
